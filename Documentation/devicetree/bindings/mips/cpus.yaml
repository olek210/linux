## Documentation/devicetree/bindings/mips/cpus.yaml
```yaml
# SPDX-License-Identifier: (GPL-2.0-only OR BSD-2-Clause)
%YAML 1.2
---
$id: http://devicetree.org/schemas/mips/cpus.yaml#
$schema: http://devicetree.org/meta-schemas/core.yaml#

title: MIPS bindings for 'cpus' DT nodes

maintainers:
  - Aleksander Jan Bajkowski <olek2@wp.pl>

description: |
  This document uses some terminology common to the RISC-V community
  that is not widely used, the definitions of which are listed here:

properties:
  compatible:
    oneOf:
      - items:
          - enum:
              - mips,m14Kc
              - mips,mips4Kc
              - mips,mips4KEc
              - mips,mips24Kc
              - mips,mips24KEc
              - mips,mips34Kc
              - mips,mips74Kc
              - mips,mips1004Kc
              - mips,mips1074Kc
              - mti,microaptiv
              - mti,interaptiv
              - mti,proaptiv
              - mti,i6400
              - mti,i6500
              - mti,i7200
              - mti,m5100
              - mti,m5150
              - mti,m6200
              - mti,m6250
              - mti,p5600
              - mti,p6600
          - const: mips

additionalProperties: true

examples:
  - |
    cpus {
        #address-cells = <1>;
        #size-cells = <0>;
        cpu@0 {
                device_type = "cpu";
                compatible = "mips,mips34Kc";
                reg = <0>;
        };
    };
```

## Documentation/devicetree/bindings/mips/lantiq/dcdc.yaml
```yaml
# SPDX-License-Identifier: GPL-2.0
%YAML 1.2
---
$id: http://devicetree.org/schemas/mips/lantiq/dcdc.yaml#
$schema: http://devicetree.org/meta-schemas/core.yaml#

title: Lantiq Xway xRX200 SoC series DCDC (DCDC)

maintainers:
  - John Crispin <john@phrozen.org>

properties:
  compatible:
    items:
      - enum:
          - lantiq,dcdc-xrx200

  reg:
    maxItems: 1

required:
  - compatible
  - reg

additionalProperties: false

examples:
  - |
    dcdc@106a00 {
        compatible = "lantiq,dcdc-xrx200";
        reg = <0x106a00 0x200>;
    };
```

## Documentation/devicetree/bindings/mips/lantiq/devices.yaml
```yaml
# SPDX-License-Identifier: (GPL-2.0-only OR BSD-2-Clause)
%YAML 1.2
---
$id: http://devicetree.org/schemas/mips/loongson/devices.yaml#
$schema: http://devicetree.org/meta-schemas/core.yaml#

title: Lantiq based Platforms Device Tree Bindings

maintainers:
  - Aleksander Jan Bajkowski <olek2@wp.pl>
description: |
  Devices with a Loongson CPU shall have the following properties.

properties:
  $nodename:
    const: '/'
  compatible:
    oneOf:

      - description: D-Link DWR966
        items:
          - const: dlink,dwr966

additionalProperties: true

...
```

## Documentation/devicetree/bindings/mips/lantiq/eiu.yaml
```yaml
# SPDX-License-Identifier: GPL-2.0
%YAML 1.2
---
$id: http://devicetree.org/schemas/mips/lantiq/eiu.yaml#
$schema: http://devicetree.org/meta-schemas/core.yaml#

title: Lantiq Xway SoC series EIU (EIU)

maintainers:
  - John Crispin <john@phrozen.org>

properties:
  compatible:
    items:
      - enum:
          - lantiq,eiu-xway

  reg:
    maxItems: 1

required:
  - compatible
  - reg
  - interrupt-parent
  - lantiq,eiu-irqs

additionalProperties: false

examples:
  - |
    eiu@101000 {
        #interrupt-cells = <1>;
        interrupt-controller;
        compatible = "lantiq,eiu-xway";
        reg = <0x101000 0x1000>;
        interrupt-parent = <&icu0>;
        lantiq,eiu-irqs = <166 135 66 40 41 42>;
	};
```

## Documentation/devicetree/bindings/mips/lantiq/gptu.yaml
```yaml
# SPDX-License-Identifier: GPL-2.0
%YAML 1.2
---
$id: http://devicetree.org/schemas/mips/lantiq/gptu.yaml#
$schema: http://devicetree.org/meta-schemas/core.yaml#

title: Lantiq Xway SoC series GPTU

maintainers:
  - John Crispin <john@phrozen.org>

properties:
  compatible:
    items:
      - enum:
          - lantiq,gptu-xway

  reg:
    maxItems: 1

required:
  - compatible
  - reg

additionalProperties: false

examples:
  - |
    gptu@e100a00 {
        compatible = "lantiq,gptu-xway";
        reg = <0xe100a00 0x100>;
        interrupt-parent = <&icu0>;
        interrupts = <126 127 128 129 130 131>;
    };
```

## Documentation/devicetree/bindings/mips/lantiq/lantiq,icu.yaml
```yaml
# SPDX-License-Identifier: (GPL-2.0-only OR BSD-2-Clause)
%YAML 1.2
---
$id: http://devicetree.org/schemas/mips/lantiq/lantiq,icu.yaml#
$schema: http://devicetree.org/meta-schemas/core.yaml#

title: Lantiq SoCs Interrupt Controller Unit (ICU) devicetree bindings

maintainers:
  - John Crispin <john@phrozen.org>

properties:
  compatible:
    oneOf:
      - enum:
          - lantiq,icu

  "#interrupt-cells":
    const: 1

  interrupt-controller: true

  reg:
    maxItems: 1

required:
  - compatible
  - "#interrupt-cells"
  - interrupt-controller
  - reg

additionalProperties: false

examples:
  - |
    icu0: icu@80200 {
        compatible = "lantiq,icu";
        #interrupt-cells = <1>;
        interrupt-controller;
        reg = <0x80200 0xc8>;
        };
```

## Documentation/devicetree/bindings/mips/lantiq/lantiq,vmmc.yaml
```yaml
# SPDX-License-Identifier: (GPL-2.0-only OR BSD-2-Clause)
%YAML 1.2
---
$id: http://devicetree.org/schemas/mips/lantiq/lantiq,vmmc.yaml#
$schema: http://devicetree.org/meta-schemas/core.yaml#

title: Lantiq Xway SoC series Voice MIPS Macro Core (VMMC)

maintainers:
  - John Crispin <john@phrozen.org>

properties:
  compatible:
    items:
      - enum:
          - lantiq,vmmc-xway

  reg:
    maxItems: 1

required:
  - compatible
  - reg

additionalProperties: false

examples:
  - |
    vmmc@107000 {
        compatible = "lantiq,vmmc-xway";
        reg = <0x107000 0x300>;
        interrupt-parent = <&icu0>;
        interrupts = <150 151 152 153 154 155>;
        gpios = <&gpio 30 GPIO_ACTIVE_HIGH  //fxs relay
                 &gpio 31 GPIO_ACTIVE_HIGH  //still unknown
                 &gpio 3  GPIO_ACTIVE_HIGH>; //reset_slic?

    };
```

## Documentation/devicetree/bindings/mips/lantiq/soc.yaml
```yaml
# SPDX-License-Identifier: (GPL-2.0-only OR BSD-2-Clause)
%YAML 1.2
---
$id: http://devicetree.org/schemas/mips/lantiq/soc.yaml#
$schema: http://devicetree.org/meta-schemas/core.yaml#

title: Lantiq SoC based Platform

maintainers:
  - Aleksander Jan Bajkowski <olek2@wp.pl>

description:
  Devices with a Lantiq CPU shall have the following properties.

properties:
  $nodename:
    const: "/"
  compatible:
    oneOf:
      - description: Boards with Lantiq Amazon-SE SoC
        items:
          - const: lantiq,ase

      - description: Boards with Lantiq Danube SoC
        items:
          - const: lantiq,danube

      - description: Boards with Lantiq Falcon SoC
        items:
          - const: lantiq,falcon

      - description: Boards with Lantiq Twinpass SoC
        items:
          - const: lantiq,twinpass

additionalProperties: true

...
```

## Documentation/devicetree/bindings/mtd/lantiq,nand.yaml
```yaml
# SPDX-License-Identifier: (GPL-2.0-only OR BSD-2-Clause)
%YAML 1.2
---
$id: http://devicetree.org/schemas/mtd/lantiq,nand.yaml#
$schema: http://devicetree.org/meta-schemas/core.yaml#

title: Lantiq Xway NAND Flash Controller devicetree bindings

maintainers:
  - Aleksander Bajkowski <olek2@wp.pl>

allOf:
  - $ref: nand-controller.yaml#

properties:
  compatible:
    enum:
      - lantiq,nand-xway

  reg:
    maxItems: 1

  bank-width:
    description:
      Width (in bytes) of the device.  If not present, the width
      defaults to 1 byte
    maxItems: 1

  partitions:
    type: object
    description:
      Node containing description of fixed partitions.
      See Documentation/devicetree/bindings/mtd/partition.txt

required:
  - compatible
  - reg

unevaluatedProperties: false

examples:
  - |
    localbus@0 {
      #address-cells = <2>;
      #size-cells = <1>;
      ranges = <0 0 0x0 0x3ffffff /* addrsel0 */
                1 0 0x4000000 0x4000010>; /* addsel1 */

      nand-controller@1 {
        compatible = "lantiq,nand-xway";
        reg = <0x1 0x0 0x2000000>;
        lantiq,cs = <1>;
        bank-width = <2>;

        #address-cells = <1>;
        #size-cells = <0>;

        pinctrl-0 = <&nand_pins>, <&nand_cs1_pins>;
        pinctrl-names = "default";

        partitions {
          compatible = "fixed-partitions";
          #address-cells = <1>;
          #size-cells = <1>;

          partition@0 {
            label = "u-boot";
            reg = <0x0 0xa0000>;
            read-only;
          };

          partition@a0000 {
            label = "u-boot-env";
            reg = <0xa0000 0x20000>;
            read-only;
          };

          partition@c0000 {
            label = "firmware";
            reg = <0xc0000 0x40000>;
          };

          partition@100000 {
            label = "ubi";
            reg = <0x100000 0x7e80000>;
          };
        };
      };
    };
```

## Documentation/devicetree/bindings/net/lantiq,etop-xway.yaml
```yaml
# SPDX-License-Identifier: (GPL-2.0-only OR BSD-2-Clause)
%YAML 1.2
---
$id: http://devicetree.org/schemas/net/lantiq,etop-xway.yaml#
$schema: http://devicetree.org/meta-schemas/core.yaml#

title: Lantiq Xway ETOP Ethernet driver

maintainers:
  - John Crispin <john@phrozen.org>

properties:
  $nodename:
    pattern: "^ethernet@[0-9a-f]+$"

  compatible:
    const: lantiq,etop-xway

  reg:
    maxItems: 1

  interrupts:
    minItems: 2
    maxItems: 8
    items:
      - description: RX interrupt Queue 0
      - description: TX interrupt Queue 0
      - description: RX interrupt Queue 1
      - description: TX interrupt Queue 1
      - description: RX interrupt Queue 2
      - description: TX interrupt Queue 2
      - description: RX interrupt Queue 3
      - description: TX interrupt Queue 3

  interrupt-names:
    minItems: 2
    maxItems: 8
    items:
      - const: rx0
      - const: tx0
      - const: rx1
      - const: tx1
      - const: rx2
      - const: tx2
      - const: rx3
      - const: tx3

  lantiq,tx-burst-length:
    $ref: /schemas/types.yaml#/definitions/uint32
    description: |
      TX programmable burst length.
    enum: [2, 4, 8]

  lantiq,rx-burst-length:
    $ref: /schemas/types.yaml#/definitions/uint32
    description: |
      RX programmable burst length.
    enum: [2, 4, 8]

  phy-mode: true

required:
  - compatible
  - reg
  - interrupts
  - interrupt-names
  - lantiq,tx-burst-length
  - lantiq,rx-burst-length
  - phy-mode

additionalProperties: false

examples:
  - |
    ethernet@e180000 {
        compatible = "lantiq,etop-xway";
        reg = <0xe180000 0x40000>;
        interrupt-parent = <&icu0>;
        interrupts = <72>, <73>, <74>, <75>, <76>, <77>, <78>, <79>;
        interrupt-names = "rx0", "tx0", "rx1", "tx1", "rx2", "tx2", "rx3", "tx3";
        lantiq,tx-burst-length = <8>;
        lantiq,rx-burst-length = <8>;
        phy-mode = "rmii";
    };
```

## Documentation/devicetree/bindings/pci/lantiq,pci-xway.yaml
```yaml
# SPDX-License-Identifier: (GPL-2.0-only OR BSD-2-Clause)
# Copyright (C) 2020 Renesas Electronics Corp.
%YAML 1.2
---
$id: http://devicetree.org/schemas/pci/rcar-pci-host.yaml#
$schema: http://devicetree.org/meta-schemas/core.yaml#

title: Renesas R-Car PCIe Host

maintainers:
  - Marek Vasut <marek.vasut+renesas@gmail.com>
  - Yoshihiro Shimoda <yoshihiro.shimoda.uh@renesas.com>

allOf:
  - $ref: pci-bus.yaml#

properties:
  compatible:
    oneOf:
      - items:
          - enum:
              - lantiq,pci-xway      # RZ/G1H

  reg:
    maxItems: 1

  interrupts:
    minItems: 3
    maxItems: 3

  clocks:
    maxItems: 2

  clock-names:
    items:
      - const: pcie
      - const: pcie_bus

  power-domains:
    maxItems: 1

  resets:
    maxItems: 1

  phys:
    maxItems: 1

  phy-names:
    const: pcie

required:
  - compatible
  - reg
  - interrupts
  - clocks
  - clock-names
  - power-domains
  - resets

unevaluatedProperties: false

examples:
  - |
    pci@e105400 {
			#address-cells = <3>;
			#size-cells = <2>;
			#interrupt-cells = <1>;
			compatible = "lantiq,pci-xway";
			bus-range = <0x0 0x0>;
			ranges = <0x2000000 0 0x8000000 0x8000000 0 0x2000000   /* pci memory */
				0x1000000 0 0x00000000 0xae00000 0 0x200000>; /* io space */
			reg = <0x7000000 0x8000         /* config space */
				0xe105400 0x400>;       /* pci bridge */
			lantiq,bus-clock = <33333333>;
			interrupt-map-mask = <0xf800 0x0 0x0 0x7>;
			interrupt-map = <0x7000 0 0 1 &icu0 30 1>; /* slot 14, irq 30 */
			req-mask = <0x1>; /* GNT1 */
    };
```
